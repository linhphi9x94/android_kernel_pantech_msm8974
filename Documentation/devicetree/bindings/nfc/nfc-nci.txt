## arch/arm/mach-msm/cust/LCD/Kconfig
```kconfig
if CUST_PANTECH_H

###################################################
# PANTECH LCD Feature Section                     #
#                                                 #
###################################################
# * Defined LCD common feature                    # 
###################################################
config MACH_MSM8974_LCD_COMMON
	bool
	default y
	select F_SKYDISP_LCD_RESET
	select F_SKYDISP_LCD_FORCE_ONOFF        
	select F_SKYDISP_SHARPNESS_CTRL
	select F_SKYDISP_BACKLIGHT_DEBUG
	select F_SKYDISP_SILENT_BOOT
	select F_SKYDISP_CMDS_CONTROL
	select F_SKYDISP_BACKLIGHT_CMDS_CTL
	select F_QUALCOMM_OVERLAY_CORRUPTION
	select F_SKYDISP_FACTORY_SLEEP_ENABLE
	select F_QUALCOMM_VIDEO_PLAYER_HALT
	select F_SKYDISP_ADJUST_MDP_BANDWIDTH
    	select F_QUALCOMM_BUGFIX_SURFACEFLINGER_PENDING	
	select F_QUALCOMM_BUGFIX_MDP_UNDERRUN
	select F_QUALCOMM_BOOTING_BLUESCREEN
	select F_QUALCOMM_MDP_RGB_LAYER_UNDERRUN
	select F_QUALCOMM_GPU_PAGETABLE_PHY_ADDRESS_ERROR
	select F_QUALCOMM_BUGFIX_KGSL_SPINLOCK_BUG
	select F_QUALCOMM_MOVIE_PLAYER_MDP_UNDERRUN
	select F_QUALCOMM_WORKAROUND_FOR_GDSC_OXILI_FAIL
###################################################
# * Defined LCD board feature                     # 
###################################################
if MACH_MSM8974_EF56S
config DEFINE_LIST_EF56S
	bool
	default y
	select F_SKYDISP_EF56_SS
	select F_SKYDISP_CABC_CONTROL
	select F_SKYDISP_SHARPNESS_CTRL
	select F_SKYDISP_BACKLIGHT_CMDS_CTL

endif

if MACH_MSM8974_EF59S
config DEFINE_LIST_EF59S
	bool
	default y
	select F_SKYDISP_EF59_SS  
	select F_SKYDISP_CABC_CONTROL
	select F_SKYDISP_SHARPNESS_CTRL
	select F_SKYDISP_BACKLIGHT_CMDS_CTL
endif

if MACH_MSM8974_EF59K
config DEFINE_LIST_EF59K
	bool
	default y
	select F_SKYDISP_EF59_SS  
	select F_SKYDISP_CABC_CONTROL
	select F_SKYDISP_SHARPNESS_CTRL
	select F_SKYDISP_BACKLIGHT_CMDS_CTL
endif

if MACH_MSM8974_EF59L
config DEFINE_LIST_EF59L
	bool
	default y
	select F_SKYDISP_EF59_SS  
	select F_SKYDISP_CABC_CONTROL
	select F_SKYDISP_SHARPNESS_CTRL
	select F_SKYDISP_BACKLIGHT_CMDS_CTL
endif

if MACH_MSM8974_EF60S
config DEFINE_LIST_EF60S
	bool
	default y
	select F_SKYDISP_EF60_SS
	select F_SKYDISP_CABC_CONTROL
	select F_SKYDISP_SHARPNESS_CTRL
	select F_SKYDISP_BACKLIGHT_CMDS_CTL
endif

if MACH_MSM8974_EF65S
config DEFINE_LIST_EF65S
	bool
	default y
	select F_SKYDISP_EF60_SS
	select F_SKYDISP_CABC_CONTROL
	select F_SKYDISP_SHARPNESS_CTRL
	select F_SKYDISP_BACKLIGHT_CMDS_CTL
endif

if MACH_MSM8974_EF61K
config DEFINE_LIST_EF61K
	bool
	default y
	select F_SKYDISP_EF60_SS
	select F_SKYDISP_CABC_CONTROL
	select F_SKYDISP_SHARPNESS_CTRL
	select F_SKYDISP_BACKLIGHT_CMDS_CTL
endif

if MACH_MSM8974_EF62L
config DEFINE_LIST_EF62L
	bool
	default y
	select F_SKYDISP_EF60_SS
	select F_SKYDISP_CABC_CONTROL
	select F_SKYDISP_SHARPNESS_CTRL
	select F_SKYDISP_BACKLIGHT_CMDS_CTL
endif

if MACH_MSM8974_EF63S
config DEFINE_LIST_EF63S
	bool
	default y
	select F_SKYDISP_EF63_SS
	select F_SKYDISP_HBM_FOR_AMOLED
	select F_SKYDISP_ELVSS_WORK
	select F_SKYDISP_SMARTDIMMING
	select F_SKYDISP_EF63_DRIVER_IC_CHECK
	select F_SKYDISP_AMOLED_READ_DATA
	select F_QUALCOMM_BWC_VIDEO_DISPLAY_HALT
endif

if MACH_MSM8974_EF63K
config DEFINE_LIST_EF63K
	bool
	default y
	select F_SKYDISP_EF63_SS
	select F_SKYDISP_HBM_FOR_AMOLED
	select F_SKYDISP_ELVSS_WORK
	select F_SKYDISP_SMARTDIMMING
	select F_SKYDISP_EF63_DRIVER_IC_CHECK
	select F_SKYDISP_AMOLED_READ_DATA
	select F_QUALCOMM_BWC_VIDEO_DISPLAY_HALT
endif

if MACH_MSM8974_EF63L
config DEFINE_LIST_EF63L
	bool
	default y
	select F_SKYDISP_EF63_SS
	select F_SKYDISP_HBM_FOR_AMOLED
	select F_SKYDISP_ELVSS_WORK
	select F_SKYDISP_SMARTDIMMING	
	select F_SKYDISP_EF63_DRIVER_IC_CHECK
	select F_SKYDISP_AMOLED_READ_DATA
	select F_QUALCOMM_BWC_VIDEO_DISPLAY_HALT
endif


##############################################################
##############################################################
#               PANTECH  FEARTURE                            # 
#                                                            #
##############################################################
##############################################################      

##############################################################
# owner  : p10443          
# date    : 2013.11.26 
# PLM    : 
# Case  :       
# Description : EF56 model LCD common
##############################################################
config F_SKYDISP_EF56_SS
	bool

##############################################################
# owner  : p10443          
# date    : 2013.11.26 
# PLM    : 
# Case  :       
# Description : EF59 Series model LCD common
##############################################################
config F_SKYDISP_EF59_SS
	bool

##############################################################
# owner  : p10443          
# date    : 2013.11.26
# PLM    : 
# Case  :       
# Description : EF60/61/62 Series model LCD common
##############################################################
config F_SKYDISP_EF60_SS
	bool

##############################################################
# owner  : p10443          
# date    : 2013.11.26 
# PLM    : 
# Case  :       
# Description : EF63 Series model LCD common
##############################################################
config F_SKYDISP_EF63_SS
	bool

##############################################################
# owner  : p13832   seunghwa_ji       
# date    : 2013.04.11 
# PLM    : 
# Case  :       
# Description : it is for cabc control
##############################################################
config F_SKYDISP_CABC_CONTROL
	bool

##############################################################
# owner  : p13832 seunghwa_ji         
# date    : 2013.04.30
# PLM    : 
# Case  :       
# Description :  it's for silentboot
##############################################################
config F_SKYDISP_SILENT_BOOT
	bool

##############################################################
# owner  : p13447 shin jaegon    
# date    : 2013.05.02 
# PLM    : 
# Case  :       
# Description : Added codes for factory command ("FACTORY_SLEEP_ENABLE_I") 
##############################################################
config F_SKYDISP_FACTORY_SLEEP_ENABLE
	bool

##############################################################
# owner  : p10443          
# date    : 2013.06.27 
# PLM    : 
# Case  :       
# Description : EF56/EF59/EF60/61/62 sharpness control
##############################################################
config F_SKYDISP_SHARPNESS_CTRL
	bool

##############################################################
# owner  : p13832    
# date    : 2013.07.02 
# PLM    : 
# Case  :       
# Description : LCD cmds Test
##############################################################
config F_SKYDISP_CMDS_CONTROL
	bool

##############################################################
# owner  : p13832    
# date    : 2013.08.19 
# PLM    : 
# Case  :       
# Description : backlight on/off
##############################################################
config F_SKYDISP_BACKLIGHT_CMDS_CTL
	bool

	
##############################################################
# owner  : p13832    
# date    : 2014.01.23 
# PLM    : 
# Case  :       
# Description : oled hbm on/off
##############################################################
config F_SKYDISP_HBM_FOR_AMOLED
	bool

##############################################################
# owner  : p13832    
# date    : 2014.01.28 
# PLM    : 
# Case  :       
# Description : oled elvss porting
##############################################################
config F_SKYDISP_ELVSS_WORK
	bool

##############################################################
# owner  : p13832    
# date    : 2014.02.04 
# PLM    : 
# Case  :       
# Description : oled smart dimming
##############################################################
config F_SKYDISP_SMARTDIMMING
	bool

##############################################################
# owner  : p12452    
# date    : 2014.03.04 
# PLM    : 
# Case  :       
# Description : driver ic manufacture_id check
##############################################################
config F_SKYDISP_EF63_DRIVER_IC_CHECK
	bool	
	

##############################################################
# owner  : p13832    
# date    : 2014.03.011 
# PLM    : 
# Case  :       
# Description : driver ic read(register)
##############################################################
config F_SKYDISP_AMOLED_READ_DATA
	bool	

	
##############################################################
##############################################################
#               QUALCOMM FEARTURE                 	         # 
#							                                 #
##############################################################
##############################################################

##############################################################
# owner  : p13832    
# date    : 2014.03.26 
# PLM    : 
# Case  :  01493568     
# Description : when aot player, overlay is broken
##############################################################
config F_QUALCOMM_OVERLAY_CORRUPTION
	bool

##############################################################
# owner  : p10443   
# date    : 2014.01.24 
# PLM    : 
# Case  : #1430521      
# Description : video player halt (1080*1920 -> 1080*607 resize play)
# TODO : official patch release check - OK (2014.01.27 official patch release)
##############################################################
config F_QUALCOMM_VIDEO_PLAYER_HALT
	bool

##############################################################
# owner  : p12226        
# date    : 2013.08.28 
# PLM    : 
# Case  :  none
# Description : mdp ab value adjusting 
##############################################################
config F_SKYDISP_ADJUST_MDP_BANDWIDTH
	bool 

##############################################################
# owner  : p10443        
# date    : 2013.11.04
# PLM    : EF60S PLM601
# Case  :  
# Description : Surfaceflinger pending cpu 90%  framework reset 			
##############################################################
config F_QUALCOMM_BUGFIX_SURFACEFLINGER_PENDING		
	bool

##############################################################
# owner  : p12452, Cho kyoungku        
# date    : 2014.01.28
# PLM    : EF61K_KK PLM154, PLM203
# Case  :  #01434521, #01433691
# Description : Watchdog reset during stability-test, cause by AHB_TIMEOUT(bus-hang)  ==> applied from cplr2147A.3'	
#			https://www.codeaurora.org/cgit/quic/la/kernel/msm/commit/?id=81dc12df9fe3d791a2228f5bdf99edba01cea036
#			https://www.codeaurora.org/cgit/quic/la/kernel/msm/commit/?id=8347e7c7297421e7e73e01a167e93335bc3e7c05
#			https://www.codeaurora.org/cgit/quic/la/kernel/msm/commit/?id=1b069a175ac8f7f86e247f88e09bb4fef5ef461f
#			https://www.codeaurora.org/cgit/quic/la/kernel/msm-3.10/commit/?h=msm-3.10&id=3fa1f13724c0af130da99348768cca46404953e7
# Related file : adreno_a3xx_snapshot.c, adreno_dispatch.c, adreno_drawctxt.c
##############################################################
config F_QUALCOMM_GPU_PATCH_FOR_BUS_HANG		
	bool	
	
##############################################################
# owner  : p16603. Kim HyunGeuk
# date    : 2014.02.10
# PLM    : EF61K_KK PLM378
# Case  :  #01438433 
# Description : Watchdog reset during stability-test, cause by AHB_TIMEOUT(bus-hang) ==> applied from cplr2147A.3'	
#			https://www.codeaurora.org/patches/quic/la/PATCH_MSM8974_45951_IOMMU_KGSL_CLK_REFCOUNT_20140206.tar.gz 
# Related file : adreno.c, kgsl_iommu.c, kgsl_iommu.h, kgsl_mmu.h, kgsl_pwrctrl.c
##############################################################
config F_QUALCOMM_GPU_PATCH_FOR_BUS_HANG_SECOND	
	bool		

##############################################################
# owner  : p12452, Cho kyoungku        
# date    : 2014.02.24
# PLM    : EF62L_KK PLM667, PLM692
# Case  :  #01455896
# Description : Watchdog reset during stability-test, cause by XPU VIOLATION	
#			https://www.codeaurora.org/cgit/quic/la/kernel/msm/commit/?h=LNX.LA.3.5.1&id=a27f180e609abc8ee33b24325c5a191b071e1651 ==> applied from cplr2147A.3'
#			https://www.codeaurora.org/cgit/quic/la/kernel/msm/commit/?id=2241b97d7abe5d980da0560e088611611c6ed823
#			https://www.codeaurora.org/cgit/quic/la/kernel/msm-3.10/commit/?h=LNX.LA.3.8_RB1.2&id=6420b92c0e37c5782cde8381fa37dcb6cd1e2ff3
#			https://www.codeaurora.org/cgit/quic/la/kernel/msm-3.10/commit/?h=LNX.LA.3.8_RB1.2&id=5cc1d013517179198fb944c48a8d39aff3ba9297
# Related file : adreno.h, adreno_a3xx.c, adreno_ringbuffer.c, adreno_profile.c
##############################################################
config F_QUALCOMM_GPU_PATCH_FOR_PAGE_FAULT		
	bool	

##############################################################
# owner  : p12452, Cho kyoungku        
# date    : 2014.03.17
# PLM    : EF63S PLM1908, PLM1911
# Case  :  #01455896
# Description : Watchdog reset during stability-test, cause by GPU_PAGE_FAULT(pid=-1 and 'kgsl-3d0:---nearby momory---')	
#			https://www.codeaurora.org/cgit/quic/la/kernel/msm-3.10/commit/?id=c108a41216caf0a0ddae7f19deb1ca2402ecfe10&h=caf%2FLNX.LA.3.5.1
# Related file : kgsl_iommu.c
##############################################################
config F_QUALCOMM_GPU_PAGETABLE_PHY_ADDRESS_ERROR		
	bool	

##############################################################
# owner  : p12452, Cho kyoungku        
# date    : 2014.04.15
# PLM    : EF63L 1384
# Case  :  #01498672
# Description : kgsl kgsl-3d0: |kgsl_pwrctrl_pwrrail| cx regulator_enable failed: -110	
#			 https://www.codeaurora.org/patches/quic/la/PATCH_8x74_25947_gdsc_remove_timeout_20130419.tar.gz 
# Related file : kernel\arch\arm\mach-msm\gdsc.c
##############################################################
config F_QUALCOMM_WORKAROUND_FOR_GDSC_OXILI_FAIL
	bool	
	
##############################################################
# owner  : p16603        
# date   : 2014.02.03
# PLM    : EF61K_KK PLM146
# Case   : #01435555
# Description : Bluscreen shown in voice recoder with rotation
##############################################################
config F_QUALCOMM_BUGFIX_MDP_UNDERRUN
	bool	
	
##############################################################
# owner  : p10443        
# date   : 2014.02.17
# PLM    : 
# Case   : #01451824
# Description : The bluescreen occurs during booting in video mode.
##############################################################
config F_QUALCOMM_BOOTING_BLUESCREEN
	bool	

##############################################################
# owner  : p14974
# date    : 2014.03.11
# PLM    : EF60S_KK 899
# Case  : 01465155
# Description : Fix MDP underrun over Full RGB 4 Layers
##############################################################
config F_QUALCOMM_MDP_RGB_LAYER_UNDERRUN
    bool	

##############################################################
# owner  : p14974
# date    : 2014.04.15
# PLM    : EF59S_KK 583
# Case  : 01518153
# Description : move mdp clk margin calculation on individual pipe
#               so that enable individual pipe decimation
##############################################################
config F_QUALCOMM_MOVIE_PLAYER_MDP_UNDERRUN
	bool
 
##############################################################
# owner  : p13832
# date    : 2014.04.18
# PLM    : 
# Case  : 01524279
# Description : kgsl spi lock(watchdog)
##############################################################
config F_QUALCOMM_BUGFIX_KGSL_SPINLOCK_BUG
    bool	

##############################################################
# owner  : p10443
# date    : 2014.07.29
# PLM    : EF63K PLM_2282
# Case  : 01629276
# Description : video play <-> recent app display halt 
##############################################################
config F_QUALCOMM_BWC_VIDEO_DISPLAY_HALT
    bool	
    
endif
```
