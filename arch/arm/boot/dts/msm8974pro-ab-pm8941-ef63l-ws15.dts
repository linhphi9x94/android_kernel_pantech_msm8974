/* Copyright (c) 2013, The Linux Foundation. All rights reserved.
 *
 * This program is free software; you can redistribute it and/or modify
 * it under the terms of the GNU General Public License version 2 and
 * only version 2 as published by the Free Software Foundation.
 *
 * This program is distributed in the hope that it will be useful,
 * but WITHOUT ANY WARRANTY; without even the implied warranty of
 * MERCHANTABILITY or FITNESS FOR A PARTICULAR PURPOSE.  See the
 * GNU General Public License for more details.
 */

/dts-v1/;

/include/ "msm8974pro-ab-pm8941.dtsi"
/include/ "msm8974-ef63l.dtsi"
/include/ "msm8974-camera-sensor-ef63.dtsi"
/include/ "msm8974-pmic-max17058-blsp5.dtsi"

/ {
	model = "Qualcomm MSM 8974Pro-AA/AB - Pantech EF63L";
	compatible = "qcom,msm8974-mtp", "qcom,msm8974", "qcom,mtp";
	qcom,board-id = <63335 0>;
};

&sdhc_1 {
	qcom,pad-pull-on = <0x0 0x3 0x3 0x1>; /* no-pull, pull-up, pull-up, pull-down */
	qcom,pad-pull-off = <0x0 0x3 0x3 0x1>; /* no-pull, pull-up, pull-up, pull-down */
	qcom,pad-drv-on = <0x4 0x4 0x4>; /* 10mA, 10mA, 10mA */
};
&usb3 {
	qcom,dwc-hsphy-init = <0x00F19DA4>; /* FEATURE_HSUSB_SET_SIGNALING_PARAM */
};
